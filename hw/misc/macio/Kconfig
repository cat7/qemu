## hw/misc/macio/Kconfig
```kconfig
config CUDA
    bool

config MAC_PMU
    bool

config MAC_DBDMA
    bool

config MACIO_GPIO
    bool

config KEYWEST_I2C
    bool
    select I2C

config TAS3004
    bool
    select I2C
```
